
/* 
   Granulising samleplayer for GinkoSynthese Grains based on Rob Bothof´s modification of speaker_pcm arduino example 
   by Michael Smith <michael@hurts.ca>
   http://playground.arduino.cc/Code/PCMAudio

   Finetuned by Leoš Hort
   https://www.facebook.com/HRTLmuzik

   Updated by Renaud Vincent
   https://www.facebook.com/wwrvmusic/

   Knob 1: sample start ; Knob 2: grain size ; Knob 3: pitch
*/

#include <stdint.h>
#include <avr/interrupt.h>
#include <avr/io.h>
#include <avr/pgmspace.h>


const signed char sounddata_data[] PROGMEM = {129, 129, 129, 129, 129, 129, 129, 129, 129, 129, 129, 129, 129,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 136, 133};

#define SAMPLE_RATE 2000
const int sounddata_length = 13551;

int ledPin = 13;
// Can be either 3 or 11, two PWM outputs connected to Timer 2
int speakerPin = 11;

volatile uint16_t sample;
volatile uint16_t samplestart;
volatile uint16_t oldsamplestart;
volatile uint16_t looplength;
volatile uint16_t minus;

byte lastSample;

void stopPlayback()
{
  // Disable playback per-sample interrupt.
  TIMSK1 &= ~_BV(OCIE1A);
  // Disable the per-sample timer completely.
  TCCR1B &= ~_BV(CS10);
  // Disable the PWM timer.
  TCCR2B &= ~_BV(CS10);
  digitalWrite(speakerPin, LOW);
}

// This is called at 8000 Hz to load the next sample.
ISR(TIMER1_COMPA_vect) {
  if (sample >= samplestart + looplength) {
    sample = samplestart;
  }
  
  if (sample >= sounddata_length) {
    sample = samplestart;
    OCR2A = 127;
  }
  else {
    OCR2A = pgm_read_byte(&sounddata_data[sample]);
  }
  ++sample;
}

void startPlayback()
{
  pinMode(speakerPin, OUTPUT);
  ASSR &= ~(_BV(EXCLK) | _BV(AS2));
  TCCR2A |= _BV(WGM21) | _BV(WGM20);
  TCCR2B &= ~_BV(WGM22);

  if (speakerPin == 11) {
    TCCR2A = (TCCR2A | _BV(COM2A1)) & ~_BV(COM2A0);
    TCCR2A &= ~(_BV(COM2B1) | _BV(COM2B0));
    // No prescaler (p.158)
    TCCR2B = (TCCR2B & ~(_BV(CS12) | _BV(CS11))) | _BV(CS10);
    OCR2A = pgm_read_byte(&sounddata_data[0]);
  } else {
    TCCR2A = (TCCR2A | _BV(COM2B1)) & ~_BV(COM2B0);
    TCCR2A &= ~(_BV(COM2A1) | _BV(COM2A0));
    TCCR2B = (TCCR2B & ~(_BV(CS12) | _BV(CS11))) | _BV(CS10);
    OCR2B = pgm_read_byte(&sounddata_data[0]);
  }

  cli();
  TCCR1B = (TCCR1B & ~_BV(WGM13)) | _BV(WGM12);
  TCCR1A = TCCR1A & ~(_BV(WGM11) | _BV(WGM10));
  TCCR1B = (TCCR1B & ~(_BV(CS12) | _BV(CS11))) | _BV(CS10);
  OCR1A = F_CPU / SAMPLE_RATE;
  TIMSK1 |= _BV(OCIE1A);

  lastSample = pgm_read_byte(&sounddata_data[sounddata_length - 1]);
  sample = 0;
  sei();
}

void setup()
{
  pinMode(ledPin, OUTPUT);
  digitalWrite(ledPin, HIGH);
  startPlayback();
  samplestart = 0;
  looplength = sounddata_length;
}

void loop()
{
  OCR1A = F_CPU / ((((analogRead(0) * 2) + (analogRead(3) * 2) / 5) - 500) * 32);

  samplestart = analogRead(2) * 26 + 500;

  //minimal grainsize, you can make it bigger by adding a number (+?)
  looplength = analogRead(1) * 26 + 300;
  minus = analogRead(1) * 26 + 300;

  if ( minus > samplestart) {
    minus = oldsamplestart;
  }

  // doesnt change retrigger when change the samplestart //
  if ((samplestart > oldsamplestart + looplength) ||
      (samplestart < oldsamplestart - minus ))
  {
    sample = samplestart;
    oldsamplestart = samplestart;
  }
}

